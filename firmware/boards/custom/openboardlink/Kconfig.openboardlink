## firmware/boards/custom/openboardlink/board.yml
```yaml
board:
  name: openboardlink
  full_name: OpenBoardLink v1.0.3
  vendor: st
  socs:
  - name: stm32f103xb
```

## firmware/boards/custom/openboardlink/openboardlink.defconfig
```kconfig
CONFIG_SYS_CLOCK_HW_CYCLES_PER_SEC=72000000
CONFIG_ARM_MPU=n
CONFIG_SERIAL=y
CONFIG_GPIO=y
```
